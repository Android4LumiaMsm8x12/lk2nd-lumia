// SPDX-License-Identifier: BSD-3-Clause

#include <skeleton64.dtsi>
#include <lk2nd.dtsi>

/ {
	// This is used by the bootloader to find the correct DTB
	qcom,msm-id = <164 10001>;

	/* All the Nokia devices are expected to use lk1st, which passes the 
	compatible to lk2nd, so no need for extra device matching. 
	These nodes are listed in no particular order. */
	nokia-rock {
    		model = "Nokia Lumia 530";
				compatible = "nokia,rock", "qcom,msm8610", "lk2nd,device";

	    	lk2nd,smd-rpm-hack-opening;
			lk2nd,relocate-fb = <0x0FF00000>;
	};
	
	nokia-vela {
		    model = "Microsoft Lumia 435";
    		    compatible = "nokia,vela", "qcom,msm8610", "lk2nd,device";

		    lk2nd,smd-rpm-hack-opening;
		    lk2nd,relocate-fb = <0x0FF00000>;
	};

	nokia-chakra {
    		model = "Microsoft Lumia 535";
				compatible = "nokia,chakra", "qcom,msm8610", "lk2nd,device";

	    	lk2nd,smd-rpm-hack-opening;
			lk2nd,relocate-fb = <0x0FF00000>;
	};
};
